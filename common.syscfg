// These arguments were used when this file was generated. They will be automatically applied on subsequent loads 
// via the GUI or CLI invocations. Run CLI with '--help' for additional information on how to override these arguments.
// @cliArgs --board "/ti/boards/CC3220SF_LAUNCHXL" --product "SimpleLinkSDK@3.20.00.06"
// @versions {"data":"2019051709","timestamp":"2019051709","tool":"1.1.792","templates":"2019051709"}

// Add a SENSORS BoosterPack boosterpack
var BOOSTXL_SENSORS = scripting.addHardware("/ti/boards/boosterpacks/BOOSTXL-SENSORS");
var SimpleLinkWifi = scripting.addModule("/ti/drivers/net/wifi/SimpleLinkWifi");
var Crypto = scripting.addModule("/ti/drivers/Crypto");
var Display = scripting.addModule("/ti/display/Display");
var DMA = scripting.addModule("/ti/drivers/DMA");
var GPIO = scripting.addModule("/ti/drivers/GPIO");
var Timer = scripting.addModule("/ti/drivers/Timer");
var Watchdog = scripting.addModule("/ti/drivers/Watchdog");
var Crypto1 = Crypto.addInstance();
var Display1 = Display.addInstance();
var GPIO1 = GPIO.addInstance();
var GPIO2 = GPIO.addInstance();
var Timer1 = Timer.addInstance();
var Watchdog1 = Watchdog.addInstance();
var SPI = scripting.addModule("/ti/drivers/SPI");
var SPI1 = SPI.addInstance();
var Capture = scripting.addModule("/ti/drivers/Capture");
var Capture1 = Capture.addInstance();
var GPIO3 = GPIO.addInstance();
var Board = scripting.addModule("/ti/drivers/Board");
var Power = scripting.addModule("/ti/drivers/Power");
// IO Retention Shutdown - IO groups to be retained during Shutdown
Power.ioRetentionShutdown = ["GRP_1"];
// Name
Power.parkPins.$name = "ti_drivers_power_PowerCC32XXPins0";
// Name - The C/C++ identifier used in applications as the index parameter passed to Crypto runtime APIs
Crypto1.$name = "Board_Crypto0";
// Name - The C/C++ identifier used in applications as the index parameter passed to Display runtime APIs
Display1.$name = "Board_Display0";
// Use Hardware - Select the hardware to use, or 'none' to use available header pins
Display1.$hardware = system.deviceData.board.components.xds110Uart;
// Use DMA
Display1.uart.useDMA = true;
// Name - The C/C++ identifier used in applications as the index parameter passed to UART runtime APIs
Display1.uart.$name = "UART_USB";
// Name
Display1.uart.uart.$name = "MyUART1";
// Use Peripheral
Display1.uart.uart.$assign = "UART0";
// Assign pin
Display1.uart.uart.txPin.$assign = "GP01"; // pin number - 55
// Assign pin
Display1.uart.uart.rxPin.$assign = "GP02"; // pin number - 57
// Assign pin
Display1.uart.uart.txDmaChannel.$assign = "UDMA_CH9";
// Assign pin
Display1.uart.uart.rxDmaChannel.$assign = "UDMA_CH8";
// Mode - Select the GPIO mode
GPIO1.mode = "Dynamic";
// Name - The C/C++ identifier used in applications as the index parameter passed to GPIO runtime APIs
GPIO1.$name = "Board_TRIG";
// Assign pin
GPIO1.gpioPin.$assign = "boosterpack.14"; // P06
// Mode - Select the GPIO mode
GPIO2.mode = "Dynamic";
// Name - The C/C++ identifier used in applications as the index parameter passed to GPIO runtime APIs
GPIO2.$name = "Board_ECHO";
// Assign pin
GPIO2.gpioPin.$assign = "boosterpack.4"; // P03
// Timer Type
Timer1.timerType = "32 Bits";
// Name - The C/C++ identifier used in applications as the index parameter passed to Timer runtime APIs
Timer1.$name = "DISTANCE_SENSOR_TIMER";
// Name
Timer1.timer.$name = "MyTimer1";
// Use Peripheral
Timer1.timer.$assign = "Timer0";
// Name - The C/C++ identifier used in applications as the index parameter passed to Watchdog runtime APIs
Watchdog1.$name = "Board_WATCHDOG0";
// Name
Watchdog1.watchdog.$name = "MyWATCHDOG1";
// Use Peripheral
Watchdog1.watchdog.$assign = "WATCHDOG0";
// Name - The C/C++ identifier used in applications as the index parameter passed to SPI runtime APIs
SPI1.$name = "Board_SPI0";
// Mode - In three pin mode the SS signal is not used.
SPI1.mode = "Four Pin SS Active Low";
// Name
SPI1.spi.$name = "MySPI1";
// Name - The C/C++ identifier used in applications as the index parameter passed to Capture runtime APIs
Capture1.$name = "Board_CAPTURE0";
// Interrupt Priority
Capture1.interruptPriority = "1";
// Name
Capture1.timer.$name = "MyTimer1";
// Use Peripheral
Capture1.timer.$assign = "Timer2";
// Assign pin
Capture1.timer.capturePin.$assign = "boosterpack.7"; // P05
// Name - The C/C++ identifier used in applications as the index parameter passed to GPIO runtime APIs
GPIO3.$name = "Board_GPIO0";
// Assign pin
GPIO3.gpioPin.$assign = "boosterpack.18"; // P08
// Suggest solution
SPI1.spi.$suggestSolution = "SPI0";
// Suggest solution
SPI1.spi.sclkPin.$suggestSolution = "45";
// Suggest solution
SPI1.spi.misoPin.$suggestSolution = "53";
// Suggest solution
SPI1.spi.mosiPin.$suggestSolution = "7";
// Suggest solution
SPI1.spi.ssPin.$suggestSolution = "50";
// Suggest solution
SPI1.spi.dmaRxChannel.$suggestSolution = "UDMA_CH30";
// Suggest solution
SPI1.spi.dmaTxChannel.$suggestSolution = "UDMA_CH31";
